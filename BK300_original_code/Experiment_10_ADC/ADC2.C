/*******************************************************************************************
* 功    能：AD模块实验
* CPU型号 ：PIC16F877A 
* 晶振    ：4MHz 
* 说明    : 调节 ADC电位器观看数码管显示ADC电压值
* 作    者：MCU2000
* 日    期：2012年10月19日
本例程在<<BK300 PIC实验板>>上调试通过
********************************************************************************************/


#include <pic.h>	      //包含PIC头文件 软件自带的头文件可以用< >
#include "BoardConfig.h"  //包含开发板硬件初始化头文件 自已写的头文件用" " 否测PICC编译会出错
__CONFIG(0x3F32);         //芯片配置字


////////////宏及变量定义//////////////////
#define u8	        unsigned char	
#define DQ	RB3				
#define DQ_DIR      TRISB3
#define DQ_HIGH()   DQ_DIR=1
#define DQ_LOW()    DQ=0;DQ_DIR=0
#define ge	0
#define shifen      1
#define baifen      2

u8      disp[3]={0,0,0};
const   u8	saomiao[3]={0x17,0x1B ,0x1D};
const   u8	table[12]={0xc0,0xf9,0xa4,0xb0,0x99,0x92,0x82,0xf8,0x80,0x90,0xff,0xbf}; 
int     caiji_val;

//延时子函数
void delayUS(u8 i)
{
     while(--i);
}

void delayMS(u8 a)
{
     do{delayUS(199);}
     while(--a);}

//------------------------------------------------


////////////显示函数//////////////////////
void xianshi(void)
{    u8 k,j,TEMP;
 
     RA3=0;                      //U3输出使能
     TEMP=0X80;                    
     
     for(k=0;k<3;k++)
     {	
//****************数码管位码****************************************************
     RC4=1;                      //U3锁存端设为高电平输出端电平随输入端而变化
     PORTD=TEMP;                 //送数码管位码
     RC4=0;                      //U3锁存端设为低电平输出端不变
//******************************************************************************     


//****************数码管段码****************************************************
     RC3=1;
     if(k==0)PORTD=table[disp[k]]&0x7f;		//个位加小数点;
     else PORTD=table[disp[k]];
     RC3=0;
//******************************************************************************

     TEMP>>=1;                //右移一位准备下一位数码管显示
     delayMS(5);              //延时一会提高数码管显示亮度
   
//****************关闭数码管显示************************************************
     RC4=1; 
     PORTD=0X00;
     RC4=0;
     delayMS(1); 
//******************************************************************************     
     }
}

////////////ADC采集函数/////////////////
void adcinit(void)
{    int	AD;
     caiji_val=0;		      //采集单元清零
     
     TRISA=0X01;		      //设置A0为输入
     PORTA=0X0F;	                  //
     ADCON1=0x0e;		      //选择左对齐方式,
     ADCON0=0x41;
     delayMS(1);
     ADGO=1;                  //开启转换过程
     while(ADGO);             //等待转换完成
     caiji_val=ADRESH;
     caiji_val=(caiji_val<<2)+(ADRESL>>6);

     AD=caiji_val*0.489;	  //0.489为比例系数,1023*0.489=5.00V
     disp[ge]=AD/100;
     disp[shifen]=AD%100/10;
     disp[baifen]=AD%100%10;
}

////////////主函数//////////////////////
void main()
{    
     Board_init();   //调用开发板硬件初始化函数
     TRISA0=1; 
     while(1)
     {
     adcinit();      //ADC初始设置
     xianshi();      //数码管显示ADC读到的电压值
      }
}

