
/********************************************************************************************
* 实验二十三: 串口发送命令控制继电器
* CPU型号：   PIC16F877A 
* 晶振：      4MHz 
* 说明:       串口调试软件波特率设为9600并设置为十立进制发送  
              通过串口调试助手向单片机发送AA继电器吸合并且LED9作为指示灯
              发送55继电器断开

注意事项:     串口调试助手需设置为十六进制发送才有效
             
* 作    者：MCU2000
* 日    期：2012年10月19日
本例程在<<BK300 PIC实验板>>上调试通过
*********************************************************************************************/
#include <pic.h>	      //包含PIC头文件 软件自带的头文件可以用< >
#include "BoardConfig.h"  //包含开发板硬件初始化头文件 自已写的头文件用" " 否测PICC编译会出错
__CONFIG(0x3F32);         //芯片配置字

void main()
 {    

     Board_init();              //调用开发板硬件初始化函数   
     TRISC=0XFF;                 //设置C口方向全为输出
     SPBRG=0X19;                 //设置波特率为9600BPS
     TXSTA=0X24;                 //使能串口发送，选择高速波特率
     RCSTA=0X90;                 //使能串口工作，连续接收
     RCIE=0X1;                   //使能接收中断
     GIE=0X1;                    //开放全局中断
     PEIE=0X1;                   //使能外部中断
     while(1);                   //等待中断
   
  }

void interrupt usart(void)
{
    if(RCIE&&RCIF)               //判断是否为串口接收中断
    {
       if(RCREG==0xaa)
       RE1=1;                    //如果接收到AA命令继电器吸合
       else if(RCREG==0X55)
       RE1=0;                    //接收到55命令继电器断开
    }
}
