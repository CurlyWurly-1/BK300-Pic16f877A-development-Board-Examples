/********************************************************************************************
* 功    能：步进电机驱动实验程序
* CPU型号： PIC16F877A 
* 晶振：    4MHz 
* 说明:     先将该实例程序下到到单片机再接将步进电机接到开发板上方的J4接口
* 注意：  由于电机比较耗电，做电机驱动实验时编程器由USB提供的电源不够用，
                 所以开发板需单独供电，可用配送的USB线给开发板供电，也可以外接5V直流电源。               
* 作    者：MCU2000
* 日    期：2012年10月19日
本例程在<<BK300 PIC实验板>>上调试通过
*********************************************************************************************/
#include <pic.h>	      //包含PIC头文件 软件自带的头文件可以用< >
#include "BoardConfig.h"  //包含开发板硬件初始化头文件 自已写的头文件用" " 否测PICC编译会出错
__CONFIG(0x3F32);         //芯片配置字

void delay(uchar a,uchar i);

void main (void)
{
  
   Board_init();              //调用开发板硬件初始化函数
   RC4=1;

   while(1)
   {
        PORTD=0XFE;
        delay(10,10);
        
        PORTD=0XFD;
        delay(10,10);

        PORTD=0XFB;
        delay(10,10);

        PORTD=0XF7;
        delay(10,10);
    }
}

////////////延时子函数/////////////////
void  delay(uchar a,uchar i)
{	
        while(--a)
        while(--i);
}

