/********************************************************************************************
* 实验三:   数码管驱动实验
* CPU型号： PIC16F877A 
* 晶振：    4MHz 
* 说明:     四位数码管实现0-9999计数
* 作    者：MCU2000
* 日    期：2012年10月19日
本例程在<<BK300 PIC实验板>>上调试通过  

*********************************************************************************************/
#include <pic.h>	      //包含PIC头文件 软件自带的头文件可以用< >
#include "BoardConfig.h"  //包含开发板硬件初始化头文件 自已写的头文件用" " 否测PICC编译会出错
__CONFIG(0x3F32);         //芯片配置字

#define uchar  unsigned char
#define uint   unsigned int
void LED_DISPLAY(void);
void delay(uchar a,uchar i);

//共阳数码管显示代码
uchar LED_DIS[]={0xc0,0xf9,0xa4,0xb0,0x99,
            0x92,0x82,0xf8,0x80,0x90,0xff};     

uchar DIS_NUM[4];          //数码管位码寄存器
void main (void)
{
     uint counter;
     
     Board_init();         //调用开发板硬件初始化函数

     while(1)
    {
       for(counter=0;counter<9999;counter++)
       {
           DIS_NUM[0]=(uchar)(counter/1000);          //计算数值的千位
           DIS_NUM[1]=(uchar)((counter%1000)/100);    //百位
           DIS_NUM[2]=(uchar)((counter%100)/10);      //十位
           DIS_NUM[3]=(uchar)(counter%10);            //个位
           LED_DISPLAY();                             //调用数码管显示
       }        
    }  
}

//数码管显示子函数
void LED_DISPLAY(void)
{
     uchar i,TEMP,k;
     RA3=0;                      //U3输出使能
     
     for(k=0;k<50;k++)
     for(TEMP=0X80,i=0;i<4;i++)
     {
     
//****************数码管位码****************************************************
     RC4=1;                      //U3锁存端设为高电平输出端电平随输入端而变化
     PORTD=TEMP;                 //送数码管位码
     RC4=0;                      //U3锁存端设为低电平输出端不变
//******************************************************************************     

//****************数码管段码****************************************************
     RC3=1;
     PORTD=LED_DIS[DIS_NUM[i]];
     RC3=0;
//******************************************************************************

     TEMP>>=1;                  //右移一位准备下一位数码管显示
     delay(10,10);              //延时一会提高数码管显示亮度
   
//****************关闭数码管显示************************************************
     RC4=1; 
     PORTD=0X00;
     RC4=0;
     delay(1,10);
//******************************************************************************     
     }
}
////////////延时子函数/////////////////
void delay(uchar a,uchar i)
{	
     while(--a)
     while(--i);
}

