
/********************************************************************************************
* 实验八:   读写内部EEPROM实验
* CPU型号： PIC16F877A 
* 晶振：    4MHz 
* 说明:     数码管第一位显示写入EEPROM的数据
            数码管第四位显示从EEPROM读出的数据了解

* 作    者：MCU2000
* 日    期：2012年10月19日
本例程在<<BK300 PIC实验板>>上调试通过
*********************************************************************************************/

#include <pic.h>	      //包含PIC头文件 软件自带的头文件可以用< >
#include "BoardConfig.h"  //包含开发板硬件初始化头文件 自已写的头文件用" " 否测PICC编译会出错
__CONFIG(0x3F32);         //芯片配置字


uchar table[]={0xc0,0xf9,0xa4,0xb0,0x99,0x92,0x82,0xf8,
                  0x80,0x90,0X88,0X83,0XC6,0XA1,0X86,0X8E,0XFF};            
uchar date1;
uchar date2;
uchar addr1;


//US级延时子函数
void delayUS(uchar i)
{
     while(--i);
}

//MS级延时子函数
void delayMS(uchar a)
{    
     do 
     {
       delayUS(400);
      }while(--a); 
}

////////////EEPROM写函数/////////////////
void write(uchar addr,uchar date)
{    while(WR==1);		//等待上一次写操作完成;
     EEADR=addr;			//写地址;		
     EEDATA=date;		//写数据;
     EEPGD=0;		//选择EEPROM为访问对象
     WREN=1;		//开放写操作使能控制
     EECON2=0X55;		//送55H到EECON2(固定的)
     EECON2=0XAA;		//送AAH到EECON2(固定的)
     WR=1;			//启动写操作
     WREN=0;		//禁止写操作发生
}

///////////EEPROM读函数/////////////////
uchar read(uchar addr)
{     EEADR=addr;		//读地址;
      RD=1;			//读操作开始;
      NOP();NOP();		//
      return(EEDATA);		//返回数据;
}

///////////显示函数////////////////////
void display(void)
{    
    
//****************第1数码管位码****************************************************
     RC4=1;                      //U3锁存端设为高电平输出端电平随输入端而变化
     PORTD=0x10;                 //送数码管位码
     RC4=0;                      //U3锁存端设为低电平输出端不变
//******************************************************************************     

//****************第一位数码管段码**********************************************
     RC3=1;
     PORTD=table[date1];	//第一个数码管显示写入EEPROM的数据;
     RC3=0;
//******************************************************************************
     delayMS(2);

//****************关闭数码管显示************************************************
     RC4=1; 
     PORTD=0X00;
     RC4=0;
     delayMS(2);
//******************************************************************************        
     

    

//****************第四位数码管位码****************************************************
     RC4=1;                      //U3锁存端设为高电平输出端电平随输入端而变化
     PORTD=0x80;                 //送数码管位码
     RC4=0;                      //U3锁存端设为低电平输出端不变
//******************************************************************************    

//****************第四位数码管段码**********************************************
     RC3=1;
     PORTD=table[date2];	//第一个数码管显示写入EEPROM的数据;
     RC3=0;
//****************************************************************************** 
     delayMS(2);

//****************关闭数码管显示************************************************
     RC4=1; 
     PORTD=0X00;
     RC4=0;
     delayMS(2);
//****************************************************************************** 
}

///////////主函数//////////////////////
void main(void)
{   
     uchar	i;	
     Board_init();              //调用开发板硬件初始化函数

     while(1)
     {	
          if(date1==10){date1=0;addr1=0;}
          write(addr1,date1);
          delayMS(10);
          date2=read(addr1);
          for(i=0;i<100;i++){display();display();}
          date1++;addr1++;
      }
}	
