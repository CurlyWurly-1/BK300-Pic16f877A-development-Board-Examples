/********************************************************************************************
* 实验六:   定时器中断实验
* 编译软件：MPLAB IDE v8.5 + PICC
* CPU型号： PIC16F877A 
* 晶振：    4MHz 
* 说明:     0-9999计数实验
* 作    者：MCU2000
* 日    期：2012年10月19日
本例程在<<BK300 PIC实验板>>上调试通过
*********************************************************************************************/
#include <pic.h>	      //包含PIC头文件 软件自带的头文件可以用< >
#include "BoardConfig.h"  //包含开发板硬件初始化头文件 自已写的头文件用" " 否测PICC编译会出错
__CONFIG(0x3F32);         //芯片配置字

void interrupt TMR2INT(void);

void LED_DISPLAY(void);
void delay(uchar a,uchar b);

uchar DIS_NUM[4];
uchar TMR2_COUTER;
uint counter;

//共阳数码管显示代码
uchar LED_DIS[]={0xc0,0xf9,0xa4,0xb0,0x99,0x92,0x82,0xf8,
                  0x80,0x90,0X88,0X83,0XC6,0XA1,0X86,0X8E,0XFF};

void main (void)
{
     Board_init(); //调用开发板硬件初始化函数
     
     RC5=0;        //锁存高电平关闭8个LED只让数码管显示     
 
     OPTION=0x07;
     INTCON=0XA0;
     TMR0=0x05;
     while(1)
     {     //计算每位数码管需显示的数值
           DIS_NUM[0]=(uchar)(counter/1000);
           DIS_NUM[1]=(uchar)((counter%1000)/100);
           DIS_NUM[2]=(uchar)((counter%100)/10);
           DIS_NUM[3]=(uchar)(counter%10);
           LED_DISPLAY();
     }
}

//中断子函数
void interrupt TMR0INT(void)
{
     T0IF=0;
     TMR2_COUTER++;
     if(TMR2_COUTER==20)
     {
         TMR2_COUTER=0;
         counter++;
     }
     TMR0=0x05;
}

//数码管显示子函数
void LED_DISPLAY(void)
{

 uchar i,TEMP;
     RA3=0;                      //U3输出使能
     TEMP=0X80;
     for(i=0;i<4;i++)
     {
     
//****************数码管位码****************************************************
     RC4=1;                      //U3锁存端设为高电平输出端电平随输入端而变化
     PORTD=TEMP;                 //送数码管位码
     RC4=0;                      //U3锁存端设为低电平输出端不变
//******************************************************************************     

//****************数码管段码****************************************************
     RC3=1;
   PORTD=LED_DIS[DIS_NUM[i]];
     RC3=0;
//******************************************************************************

     TEMP>>=1;                 //右移一位准备下一位数码管显示
     delay(10,10);              //延时一会提高数码管显示亮度
   
//****************关闭数码管显示************************************************
     RC4=1; 
     PORTD=0X00;
     RC4=0;
     delay(1,10);
//******************************************************************************     
  }

}
////////////延时子函数/////////////////
void delay(uchar a,uchar b)
{	
    while(--a)
    while(--b);
}
